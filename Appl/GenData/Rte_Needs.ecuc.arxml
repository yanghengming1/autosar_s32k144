AUTOSAR XML (schema 4-0-3)
package /DaVinci_Project
  module config Com
    ComConfig
      sig_LampCnt_omsg_MyECU_Lamp_oCAN00_f37e68ea_Tx (ComSignal): ComSignalType=UINT8
      sig_RearInteriorLight_omsg_Transmit_oCAN00_49a633c1_Tx (ComSignal): ComSignalType=BOOLEAN
  module config Rte
    17 x RteBswModuleInstance:
      BswM
        BswM_MainFunctionTimingEvent0 (RteBswEventToTaskMapping): RteBswUsedOsEventRef=Rte_Ev_Cyclic2_OsTask_BSW_SCHM_0_10ms, RteBswUsedOsAlarmRef=Os/Rte_Al_TE2_OsTask_BSW_SCHM_0_10ms
      Can
        3 x RteBswEventToTaskMapping, all with RteBswUsedOsEventRef=Rte_Ev_Cyclic2_OsTask_BSW_SCHM_0_10ms, RteBswUsedOsAlarmRef=Os/Rte_Al_TE2_OsTask_BSW_SCHM_0_10ms:
          Can_MainFunction_BusOffTimingEvent0
          Can_MainFunction_ModeTimingEvent0
          Can_MainFunction_WakeupTimingEvent0
      CanIf
      CanSM
        CanSM_MainFunctionTimingEvent0 (RteBswEventToTaskMapping): RteBswUsedOsEventRef=Rte_Ev_Cyclic2_OsTask_BSW_SCHM_0_10ms, RteBswUsedOsAlarmRef=Os/Rte_Al_TE2_OsTask_BSW_SCHM_0_10ms
      CanTp
        CanTp_MainFunctionTimingEvent0 (RteBswEventToTaskMapping): RteBswUsedOsEventRef=Rte_Ev_Run_CanTp_CanTp_MainFunction, RteBswUsedOsAlarmRef=Os/Rte_Al_TE_CanTp_CanTp_MainFunction
      Com
        Com_MainFunctionRxTimingEvent0 (RteBswEventToTaskMapping): RteBswUsedOsEventRef=Rte_Ev_Cyclic2_OsTask_BSW_SCHM_0_10ms, RteBswUsedOsAlarmRef=Os/Rte_Al_TE2_OsTask_BSW_SCHM_0_10ms
        Com_MainFunctionTxTimingEvent0 (RteBswEventToTaskMapping): RteBswUsedOsEventRef=Rte_Ev_Cyclic2_OsTask_BSW_SCHM_0_10ms, RteBswUsedOsAlarmRef=Os/Rte_Al_TE2_OsTask_BSW_SCHM_0_10ms
      ComM
        ComM_MainFunction_0TimingEvent0 (RteBswEventToTaskMapping): RteBswUsedOsEventRef=Rte_Ev_Cyclic2_OsTask_BSW_SCHM_0_20ms, RteBswUsedOsAlarmRef=Os/Rte_Al_TE2_OsTask_BSW_SCHM_0_20ms
      Dcm
        Dcm_MainFunctionTimingEvent0 (RteBswEventToTaskMapping): RteBswUsedOsEventRef=Rte_Ev_Cyclic2_OsTask_BSW_SCHM_0_10ms, RteBswUsedOsAlarmRef=Os/Rte_Al_TE2_OsTask_BSW_SCHM_0_10ms
      Dem
        Dem_MasterMainFunctionTimingEvent0 (RteBswEventToTaskMapping): RteBswUsedOsEventRef=Rte_Ev_Cyclic2_OsTask_BSW_SCHM_0_10ms, RteBswUsedOsAlarmRef=Os/Rte_Al_TE2_OsTask_BSW_SCHM_0_10ms
        Dem_SatelliteMainFunctionTimingEvent0 (RteBswEventToTaskMapping): RteBswUsedOsEventRef=Rte_Ev_Cyclic2_OsTask_BSW_SCHM_0_10ms, RteBswUsedOsAlarmRef=Os/Rte_Al_TE2_OsTask_BSW_SCHM_0_10ms
      Det
      Dio
      EcuM
        EcuM_MainFunctionTimingEvent0 (RteBswEventToTaskMapping): RteBswUsedOsEventRef=Rte_Ev_Cyclic2_OsTask_BSW_SCHM_0_10ms, RteBswUsedOsAlarmRef=Os/Rte_Al_TE2_OsTask_BSW_SCHM_0_10ms
      Gpt
      Mcu
      PduR
      Port
      Spi
        Spi_MainFunction_HandlingTimingEvent0 (RteBswEventToTaskMapping)
    14 x RteSwComponentInstance:
      BswM_EcuSwComposition
        Timer_BswM_MainFunction (RteEventToTaskMapping): RteUsedOsEventRef=Rte_Ev_Cyclic2_OsTask_BSW_SCHM_0_10ms, RteUsedOsAlarmRef=Os/Rte_Al_TE2_OsTask_BSW_SCHM_0_10ms
      CPUload_SWC_EcuSwComposition
        TMT_CPUload_Runnable_1s (RteEventToTaskMapping): RteUsedOsAlarmRef=Os/Rte_Al_TE_CPUload_SWC_CPUload_Runnable_1s
      Cdd_SBC_UJA1169_EcuSwComposition
        TMT_Sbc_Test_Runnable (RteEventToTaskMapping): RteUsedOsEventRef=Rte_Ev_Run_Cdd_SBC_UJA1169_Sbc_Test_Runnable, RteUsedOsAlarmRef=Os/Rte_Al_TE_Cdd_SBC_UJA1169_Sbc_Test_Runnable
      ComM_EcuSwComposition
        Timer_ComM_MainFunction_0 (RteEventToTaskMapping): RteUsedOsEventRef=Rte_Ev_Cyclic2_OsTask_BSW_SCHM_0_20ms, RteUsedOsAlarmRef=Os/Rte_Al_TE2_OsTask_BSW_SCHM_0_20ms
      CpLedTask_EcuSwComposition
        TMT_LedRunnable (RteEventToTaskMapping): RteUsedOsEventRef=Rte_Ev_Run_CpLedTask_LedRunnable, RteUsedOsAlarmRef=Os/Rte_Al_TE_CpLedTask_LedRunnable
      Dcm_EcuSwComposition
        Timer_Dcm_MainFunction (RteEventToTaskMapping): RteUsedOsEventRef=Rte_Ev_Cyclic2_OsTask_BSW_SCHM_0_10ms, RteUsedOsAlarmRef=Os/Rte_Al_TE2_OsTask_BSW_SCHM_0_10ms
      DemMaster_0_EcuSwComposition
        Timer_Dem_MasterMainFunction (RteEventToTaskMapping): RteUsedOsEventRef=Rte_Ev_Cyclic2_OsTask_BSW_SCHM_0_10ms, RteUsedOsAlarmRef=Os/Rte_Al_TE2_OsTask_BSW_SCHM_0_10ms
      DemSatellite_0_EcuSwComposition
        Timer_Dem_SatelliteMainFunction (RteEventToTaskMapping): RteUsedOsEventRef=Rte_Ev_Cyclic2_OsTask_BSW_SCHM_0_10ms, RteUsedOsAlarmRef=Os/Rte_Al_TE2_OsTask_BSW_SCHM_0_10ms
      Det_EcuSwComposition
      EMC_SWC_EcuSwComposition
        TMT_EMC_Runnable_10ms (RteEventToTaskMapping): RteUsedOsEventRef=Rte_Ev_Run_EMC_SWC_EMC_Runnable_10ms, RteUsedOsAlarmRef=Os/Rte_Al_TE_EMC_SWC_EMC_Runnable_10ms
      EcuM_EcuSwComposition
        Timer_EcuM_MainFunction (RteEventToTaskMapping): RteUsedOsEventRef=Rte_Ev_Cyclic2_OsTask_BSW_SCHM_0_10ms, RteUsedOsAlarmRef=Os/Rte_Al_TE2_OsTask_BSW_SCHM_0_10ms
      LOCK_SWC_EcuSwComposition
        TMT_DLK_Runnable_100ms (RteEventToTaskMapping): RteUsedOsAlarmRef=Os/Rte_Al_TE_LOCK_SWC_DLK_Runnable_100ms
      Os_OsCore0_swc_EcuSwComposition
      PWL_SWC_EcuSwComposition
        TMT_PWL_Runnable_20ms (RteEventToTaskMapping): RteUsedOsEventRef=Rte_Ev_Run_PWL_SWC_PWL_Runnable_20ms, RteUsedOsAlarmRef=Os/Rte_Al_TE_PWL_SWC_PWL_Runnable_20ms
    RteOsInteraction
      9 x RteUsedOsActivation, all with RteExpectedActivationOffset=0:
        Rte_Al_TE_Cdd_SBC_UJA1169_Sbc_Test_Runnable: RteActivationOsAlarmRef=Os/Rte_Al_TE_Cdd_SBC_UJA1169_Sbc_Test_Runnable, RteActivationOsTaskRef=OsTask_APP
        Rte_Al_TE_CpLedTask_LedRunnable: RteActivationOsAlarmRef=Os/Rte_Al_TE_CpLedTask_LedRunnable, RteActivationOsTaskRef=OsTask_APP
        Rte_Al_TE2_OsTask_BSW_SCHM_0_10ms: RteActivationOsAlarmRef=Os/Rte_Al_TE2_OsTask_BSW_SCHM_0_10ms, RteActivationOsTaskRef=OsTask_BSW_SCHM
        Rte_Al_TE2_OsTask_BSW_SCHM_0_20ms: RteActivationOsAlarmRef=Os/Rte_Al_TE2_OsTask_BSW_SCHM_0_20ms, RteActivationOsTaskRef=OsTask_BSW_SCHM
        Rte_Al_TE_CanTp_CanTp_MainFunction: RteActivationOsAlarmRef=Os/Rte_Al_TE_CanTp_CanTp_MainFunction, RteActivationOsTaskRef=OsTask_BSW_SCHM
        Rte_Al_TE_CPUload_SWC_CPUload_Runnable_1s: RteActivationOsAlarmRef=Os/Rte_Al_TE_CPUload_SWC_CPUload_Runnable_1s, RteActivationOsTaskRef=OsTask_CPUload_1s
        Rte_Al_TE_LOCK_SWC_DLK_Runnable_100ms: RteActivationOsAlarmRef=Os/Rte_Al_TE_LOCK_SWC_DLK_Runnable_100ms, RteActivationOsTaskRef=OsTask_DLK_100ms
        Rte_Al_TE_EMC_SWC_EMC_Runnable_10ms: RteActivationOsAlarmRef=Os/Rte_Al_TE_EMC_SWC_EMC_Runnable_10ms, RteActivationOsTaskRef=OsTask_EMC_PWL
        Rte_Al_TE_PWL_SWC_PWL_Runnable_20ms: RteActivationOsAlarmRef=Os/Rte_Al_TE_PWL_SWC_PWL_Runnable_20ms, RteActivationOsTaskRef=OsTask_EMC_PWL
  module config NvM
  module config Os
    OsTask_APP (OsTask):
      OsTaskActivation = 1
      OsTaskPriority = 15
      OsTaskSchedule = NON
      OsTaskEventRef = Rte_Ev_Run_Cdd_SBC_UJA1169_Sbc_Test_Runnable
      OsTaskEventRef = Rte_Ev_Run_CpLedTask_LedRunnable
    Rte_Al_TE_Cdd_SBC_UJA1169_Sbc_Test_Runnable (OsAlarm): OsAlarmCounterRef=SystemTimer
      OsAlarmAction
        OsAlarmSetEvent: OsAlarmSetEventRef=Rte_Ev_Run_Cdd_SBC_UJA1169_Sbc_Test_Runnable, OsAlarmSetEventTaskRef=OsTask_APP
    Rte_Al_TE_CpLedTask_LedRunnable (OsAlarm): OsAlarmCounterRef=SystemTimer
      OsAlarmAction
        OsAlarmSetEvent: OsAlarmSetEventRef=Rte_Ev_Run_CpLedTask_LedRunnable, OsAlarmSetEventTaskRef=OsTask_APP
    OsTask_BSW_SCHM (OsTask):
      OsTaskActivation = 1
      OsTaskPriority = 10
      OsTaskSchedule = NON
      OsTaskEventRef = Rte_Ev_Cyclic2_OsTask_BSW_SCHM_0_10ms
      OsTaskEventRef = Rte_Ev_Cyclic2_OsTask_BSW_SCHM_0_20ms
      OsTaskEventRef = Rte_Ev_Run_CanTp_CanTp_MainFunction
    3 x OsAlarm, all with OsAlarmCounterRef=SystemTimer:
      Rte_Al_TE2_OsTask_BSW_SCHM_0_10ms
        OsAlarmAction
          OsAlarmSetEvent: OsAlarmSetEventRef=Rte_Ev_Cyclic2_OsTask_BSW_SCHM_0_10ms, OsAlarmSetEventTaskRef=OsTask_BSW_SCHM
      Rte_Al_TE2_OsTask_BSW_SCHM_0_20ms
        OsAlarmAction
          OsAlarmSetEvent: OsAlarmSetEventRef=Rte_Ev_Cyclic2_OsTask_BSW_SCHM_0_20ms, OsAlarmSetEventTaskRef=OsTask_BSW_SCHM
      Rte_Al_TE_CanTp_CanTp_MainFunction
        OsAlarmAction
          OsAlarmSetEvent: OsAlarmSetEventRef=Rte_Ev_Run_CanTp_CanTp_MainFunction, OsAlarmSetEventTaskRef=OsTask_BSW_SCHM
    OsTask_CPUload_1s (OsTask): OsTaskActivation=3, OsTaskPriority=20, OsTaskSchedule=FULL
    Rte_Al_TE_CPUload_SWC_CPUload_Runnable_1s (OsAlarm): OsAlarmCounterRef=SystemTimer
      OsAlarmAction
        OsAlarmActivateTask: OsAlarmActivateTaskRef=OsTask_CPUload_1s
    OsTask_DLK_100ms (OsTask): OsTaskActivation=3, OsTaskPriority=25, OsTaskSchedule=FULL
    Rte_Al_TE_LOCK_SWC_DLK_Runnable_100ms (OsAlarm): OsAlarmCounterRef=SystemTimer
      OsAlarmAction
        OsAlarmActivateTask: OsAlarmActivateTaskRef=OsTask_DLK_100ms
    OsTask_EMC_PWL (OsTask):
      OsTaskActivation = 1
      OsTaskPriority = 20
      OsTaskSchedule = FULL
      OsTaskEventRef = Rte_Ev_Run_EMC_SWC_EMC_Runnable_10ms
      OsTaskEventRef = Rte_Ev_Run_PWL_SWC_PWL_Runnable_20ms
    Rte_Al_TE_EMC_SWC_EMC_Runnable_10ms (OsAlarm): OsAlarmCounterRef=SystemTimer
      OsAlarmAction
        OsAlarmSetEvent: OsAlarmSetEventRef=Rte_Ev_Run_EMC_SWC_EMC_Runnable_10ms, OsAlarmSetEventTaskRef=OsTask_EMC_PWL
    Rte_Al_TE_PWL_SWC_PWL_Runnable_20ms (OsAlarm): OsAlarmCounterRef=SystemTimer
      OsAlarmAction
        OsAlarmSetEvent: OsAlarmSetEventRef=Rte_Ev_Run_PWL_SWC_PWL_Runnable_20ms, OsAlarmSetEventTaskRef=OsTask_EMC_PWL
    7 x OsEvent:
      Rte_Ev_Cyclic2_OsTask_BSW_SCHM_0_10ms
      Rte_Ev_Cyclic2_OsTask_BSW_SCHM_0_20ms
      Rte_Ev_Run_CanTp_CanTp_MainFunction
      Rte_Ev_Run_Cdd_SBC_UJA1169_Sbc_Test_Runnable
      Rte_Ev_Run_CpLedTask_LedRunnable
      Rte_Ev_Run_EMC_SWC_EMC_Runnable_10ms
      Rte_Ev_Run_PWL_SWC_PWL_Runnable_20ms
  module config EcuC
  ecuc value collection DaVinci_Project: ecuc-values=[Com, Rte, Os, EcuC, NvM]
