AUTOSAR XML (schema 4-2-1)
package /ActiveEcuC
  module config EcuC: implementation-config-variant=VARIANT-PRE-COMPILE, module-description=EcuC_Impl
    EcucPduCollection: PduIdTypeEnum=UINT8, PduLengthTypeEnum=UINT16
      21 x Pdu, all with J1939Requestable=false:
        msg_Transmit_oCAN00_9631a86b_Tx: PduLength=1, SysTPduToFrameMappingRef=msg_Transmit
        msg_diag_Request_MyECU_Tp_oCAN00_ecbacca2_Rx: PduLength=8, SysTPduToFrameMappingRef=msg_diag_Request_MyECU_Tp
        msg_diag_Response_MyECU_oCAN00_f4dcbbcd_Tx: PduLength=8
        msg_Receive_oCAN00_3867e0b8_Rx: PduLength=1, SysTPduToFrameMappingRef=msg_Receive
        msg_Transmit_oCAN00_0723e95e_Tx: PduLength=8
        msg_diag_Request_MyECU_oCAN00_a823f7ba_Rx: PduLength=8
        msg_diag_RequestGlobal_oCAN00_25be229e_Rx: PduLength=7
        msg_diag_Response_MyECU_oCAN00_45311294_Tx: PduLength=8
        msg_MyECU_Lamp_oCAN00_26f3473b_Tx: PduLength=8, SysTPduToFrameMappingRef=msg_MyECU_Lamp
        msg_diag_Request_MyECU_oCAN00_956934ec_Rx: PduLength=8
        msg_diag_Response_MyECU_Tp_oCAN00_0ed9d144_Tx: PduLength=8, SysTPduToFrameMappingRef=msg_diag_Response_MyECU_Tp
        msg_diag_RequestGlobal_oCAN00_38f4a687_Rx: PduLength=7
        msg_Receive_oCAN00_2b456e3f_Rx: PduLength=1
        msg_diag_RequestGlobal_Tp_oCAN00_7b1e9193_Rx: PduLength=8, SysTPduToFrameMappingRef=msg_diag_RequestGlobal_Tp
        msg_MyECU_Lamp_oCAN00_818e1651_Tx: PduLength=8
        MyECU2_Ipdu_com2pdur: PduLength=8
        MyECU2_Ipdu_pdur2canif: PduLength=8
        msg_Receive2_oCAN00_e16b911a_Rx: PduLength=8, SysTPduToFrameMappingRef=msg_Receive2
        msg_Receive2_oCAN00_adb9646b_Rx: PduLength=8
        Rear_MyECU_oCAN00_ca7e15e0_Tx: PduLength=1
        Rear_MyECU_oCAN00_3a26a20f_Tx: PduLength=1, SysTPduToFrameMappingRef=Rear_MyECU
    EcucGeneral:
      CPUType = CPU32Bit
      SizeOfInt = Size32Bit
      ByteOrder = LITTLE_ENDIAN
      BitOrder = LSB_to_MSB
      AtomicBitAccessInBitfield = false
      AtomicVariableAccess = Atomic32BitAccess
      SizeOfEnum = Size32Bit
      SizeOfROMPointer = Size32Bit
      SizeOfRAMPointer = Size32Bit
      BitFieldDataType = INT
      StructAlignment = Auto
      ArrayAlignment = Auto
      StructInArrayAlignment = Auto
      DummyFunction = false
      EcuCSafeBswChecks = false
      DummyStatement = true
      DummyStatementKind = SelfAssignment
      ConditionalGenerating = true
      EcucBswImplementationCodeType = EcuCSourceCode
      EcuCUseStdReturnTypeForRte = false
      BswInitialization
        32 x InitFunction:
          BswM_Init: Header=BswM.h, InitPhase=NO_INIT, ConfigType=BswM_ConfigType, ConfigPtrName=BswM_Config_Ptr, ConfigPtrClass=BSWM_INIT_DATA, ModuleRef=BswM
          BswM_InitMemory: Header=BswM.h, InitPhase=INIT_MEMORY, ModuleRef=BswM
          CanIf_Init: Header=CanIf.h, InitPhase=INIT_TWO_IF, ConfigType=CanIf_ConfigType, ConfigPtrName=CanIf_Config_Ptr, ConfigPtrClass=CANIF_INIT_DATA, ModuleRef=CanIf
          CanIf_InitMemory: Header=CanIf.h, InitPhase=INIT_MEMORY, ModuleRef=CanIf
          CanSM_Init: Header=CanSM_EcuM.h, InitPhase=INIT_TWO_SM, ConfigType=CanSM_ConfigType, ConfigPtrName=CanSM_Config_Ptr, ConfigPtrClass=CANSM_INIT_DATA, ModuleRef=CanSM
          CanSM_InitMemory: Header=CanSM_EcuM.h, InitPhase=INIT_MEMORY, ModuleRef=CanSM
          CanTp_InitMemory: Header=CanTp.h, InitPhase=INIT_MEMORY, ModuleRef=CanTp
          CanTp_Init: Header=CanTp.h, InitPhase=INIT_TWO_TP, ConfigType=CanTp_ConfigType, ConfigPtrName=CanTp_Config_Ptr, ConfigPtrClass=CANTP_INIT_DATA, ModuleRef=CanTp
          Can_Init: Header=Can.h, InitPhase=INIT_TWO_DRV, ConfigType=Can_ConfigType, ConfigPtrName=Can_Config_Ptr, ConfigPtrClass=CAN_INIT_DATA, ModuleRef=Can
          Can_InitMemory: Header=Can.h, InitPhase=INIT_MEMORY, ModuleRef=Can
          ComM_Init: Header=ComM.h, InitPhase=INIT_TWO_POST_NVMREADALL, ModuleRef=ComM
          ComM_InitMemory: Header=ComM.h, InitPhase=INIT_MEMORY, ModuleRef=ComM
          Com_InitMemory: Header=Com.h, InitPhase=INIT_MEMORY, ModuleRef=Com
          Com_Init: Header=Com.h, InitPhase=INIT_TWO_COM, ConfigType=Com_ConfigType, ConfigPtrName=Com_Config_Ptr, ConfigPtrClass=COM_INIT_DATA, ModuleRef=Com
          Dcm_Init: Header=Dcm.h, InitPhase=INIT_TWO_POST_NVMREADALL, ConfigType=Dcm_ConfigType, ConfigPtrName=NULL_PTR, ConfigPtrClass=DCM_CONST, ModuleRef=Dcm
          Dcm_InitMemory: Header=Dcm.h, InitPhase=INIT_MEMORY, ModuleRef=Dcm
          Det_Init: Header=Det.h, InitPhase=INIT_ZERO, ConfigType=Det_ConfigType, ConfigPtrName=Det_Config_Ptr, ConfigPtrClass=DET_INIT_DATA, ModuleRef=Det
          Det_InitMemory: Header=Det.h, InitPhase=INIT_MEMORY, ModuleRef=Det
          EcuM_Init: Header=EcuM.h, InitPhase=NO_INIT, ConfigType=EcuM_PbConfigType, ConfigPtrName=EcuM_Config_Ptr, ConfigPtrClass=ECUM_INIT_DATA, ModuleRef=EcuM
          Mcu_Init: Header=Mcu.h, InitPhase=INIT_ONE_EARLY, ConfigType=Mcu_ConfigType, ConfigPtrName=&McuModuleConfiguration, ConfigPtrClass=MCU_APPL_CONST, AdditionalInitCode=Mcu_InitClock(McuConf_McuClockSettingConfig_McuClockSettingConfig_0); while (MCU_PLL_LOCKED != Mcu_GetPllStatus()); Mcu_DistributePllClock();, ModuleRef=Mcu
          PduR_Init: Header=PduR.h, InitPhase=INIT_TWO_COM, ConfigType=PduR_PBConfigType, ConfigPtrName=PduR_Config_Ptr, ConfigPtrClass=PDUR_INIT_DATA, ModuleRef=PduR
          PduR_InitMemory: Header=PduR.h, InitPhase=INIT_MEMORY, ModuleRef=PduR
          Port_Init: Header=Port.h, InitPhase=INIT_ONE_EARLY, ConfigType=Port_ConfigType, ConfigPtrName=&PortConfigSet, ConfigPtrClass=PORT_APPL_CONST, ModuleRef=Port
          SchM_Init: Header=Rte_Main.h, InitPhase=NO_INIT, ModuleRef=Rte
          Rte_InitMemory: Header=Rte_Main.h, InitPhase=INIT_MEMORY, ModuleRef=Rte
          Dem_InitMemory: Header=Dem.h, InitPhase=INIT_MEMORY, ModuleRef=Dem
          Dem_Init: Header=Dem.h, InitPhase=INIT_TWO_POST_NVMREADALL, ConfigType=Dem_ConfigType, ConfigPtrName=Dem_Config_Ptr, ConfigPtrClass=DEM_INIT_DATA, ModuleRef=Dem
          Dem_PreInit: Header=Dem.h, InitPhase=INIT_ZERO, ConfigType=Dem_ConfigType, ConfigPtrName=Dem_Config_Ptr, ConfigPtrClass=DEM_INIT_DATA, ModuleRef=Dem
          Spi_Init: Header=Spi.h, InitPhase=INIT_ONE, ConfigType=Spi_ConfigType, ConfigPtrName=NULL_PTR, ConfigPtrClass=SPI_APPL_CONST, ModuleRef=Spi
          Gpt_Init: Header=Gpt.h, InitPhase=INIT_ONE, ConfigType=Gpt_ConfigType, ConfigPtrName=NULL_PTR, ConfigPtrClass=GPT_APPL_CONST, ModuleRef=Gpt
          WdgM_Init: Header=WdgM.h, InitPhase=INIT_TWO_IF, ConfigType=WdgM_ConfigType, ConfigPtrName=&WdgMConfig_Mode0_core0, ConfigPtrClass=WDGM_APPL_CONST, ModuleRef=WdgM
          Wdg_Init: Header=Wdg.h, InitPhase=INIT_ONE, ConfigType=Wdg_ConfigType, ConfigPtrName=NULL_PTR, ConfigPtrClass=WDG_APPL_CONST, ModuleRef=Wdg
    EcucHardware
      EcucCoreDefinition: EcucCoreId=0
