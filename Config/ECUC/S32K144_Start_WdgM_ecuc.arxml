AUTOSAR XML (schema 4-2-1)
package /ActiveEcuC
  module config WdgM: implementation-config-variant=VARIANT-PRE-COMPILE, module-description=WdgM_Impl
    WdgMConfigSet: WdgMInitialMode=WdgMMode
      WdgMMode:
        WdgMExpiredSupervisionCycleTol = 2
        WdgMModeId = 0
        WdgMSupervisionCycle = 0.05
        WdgMInitialTriggerModeId = 0
        WdgMModeCoreAssignment = 0
        WdgMTicksPerSecond = 20
        WdgMReportStatusViaRte = true
        WdgMAliveSupervision: WdgMExpectedAliveIndications=1, WdgMMaxMargin=1, WdgMMinMargin=1, WdgMSupervisionReferenceCycle=3, WdgMAliveSupervisionCheckpointRef=WdgMCheckpoint
        WdgMLocalStatusParams:
          WdgMFailedAliveSupervisionRefCycleTol = 2
          WdgMSupervisedEntityInitialMode = WDGM_LOCAL_STATUS_OK
          WdgMFailedDeadlineRefCycleTol = 0
          WdgMDeadlineReferenceCycle = 0
          WdgMFailedProgramFlowRefCycleTol = 0
          WdgMProgramFlowReferenceCycle = 0
          WdgMLocalStatusSupervisedEntityRef = WdgMSupervisedEntity
        WdgMTrigger: WdgMWatchdogMode=WDGIF_FAST_MODE, WdgMTriggerConditionValue=200, WdgMTriggerModeId=0, WdgMTriggerWatchdogRef=WdgMWatchdog
    WdgMGeneral:
      WdgMDevErrorDetect = true
      WdgMDemReport = false
      WdgMImmediateReset = true
      WdgMOffModeEnabled = false
      WdgMVersionInfoApi = false
      WdgMDefensiveBehavior = false
      WdgMUseRte = true
      WdgMDemSupervisionReport = false
      WdgMFirstCycleAliveCounterReset = false
      WdgMAutosarDebugging = false
      WdgMUseOsSuspendInterrupt = true
      WdgMTimebaseSource = WDGM_INTERNAL_SOFTWARE_TICK
      WdgMSecondResetPath = true
      WdgMTickOverrunCorrection = false
      WdgMEntityDeactivationEnabled = false
      WdgMGenerateCPIdAsPortDefinedArgument = false
      WdgMStatusReportingMechanism = WDGM_USE_MODE_SWITCH_PORTS
      WdgMCallerIds: WdgMCallerId=0
      WdgMSupervisedEntity: WdgMSupervisedEntityId=0, WdgMEnableEntityDeactivation=false, WdgMReportStatusViaRte=true, WdgMInternalCheckpointInitialRef=WdgMCheckpoint
        WdgMCheckpoint: WdgMCheckpointId=0
      WdgMWatchdog: WdgMWatchdogName=, WdgMWatchdogDeviceRef=WdgIfDevice
