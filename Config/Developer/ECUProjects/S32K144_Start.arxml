AUTOSAR XML (schema 00044)
package /VehicleProject
  system System
    root-software-compositions:
      root sw composition prototype EcuSwComposition: software-composition=ECU_Composition
package /ECUCompositionTypes
  composition sw component type ECU_Composition
    6 x component:
      CpLedTask: type=CtLedTask
      Cdd_SBC_UJA1169: type=CddSbc
      EMC_SWC: type=EMC
      LOCK_SWC: type=LOCK
      PWL_SWC: type=PWL
      CPUload_SWC: type=CPUload
package /EndToEndProtections
  end to end protection set EndToEndProtectionSet
